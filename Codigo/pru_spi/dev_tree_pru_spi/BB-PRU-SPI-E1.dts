/dts-v1/;
/plugin/;

/ {
    compatible = "ti,beaglebone", "ti,beaglebone-black";

    part-number = "BB-PRU-SPI-E1";
    version = "00A0";

    /* This overlay uses the following resources
    /                RST      DRDY     CS       MOSI     MISO     CLK      41b      SAMP    */
    exclusive-use = "P9.25", "P9.27", "P9.28", "P9.29", "P9.30", "P9.31", "P9.41", "P8.46", "pru0", "pru1";

    fragment@0 {
        target = <&am33xx_pinmux>;
        __overlay__ {
            // The PRU pin modes
            pru_pru_pins: pinmux_pru_pru_pins {
                pinctrl-single,pins = <
                    // SPI
                    0x190 0x0d  // CLK          P9_31   pr1_pru0_pru_r30_0,   OUTPUT | DIS |  MODE5 ->  00001101=0x0d
                    0x194 0x2e  // MISO         P9_29   pr1_pru0_pru_r31_1,   INPUT  | DIS |  MODE6 ->  00101110=0x2e
                    0x198 0x0d  // MOSI         P9_30   pr1_pru0_pru_r30_2,   OUTPUT | DIS |  MODE5 ->  00001101=0x0d
                    0x19c 0x0d  // CS           P9_28   pr1_pru0_pru_r30_3,   OUTPUT | DIS |  MODE5 ->  00001101=0x0d

                    // GPIOS
                    0x1ac 0x0d  // RESET        P9_25   pr1_pru0_pru_r30_7,   OUTPUT | DIS |  MODE5 ->  00001101=0x0d
                    0x1a4 0x2e  // DRDY         P9_27   pr1_pru0_pru_r31_5,   INPUT  | DIS |  MODE6 ->  00101110=0x2e
                    0x1a8 0x0d  // START        P9_41b  pr1_pru0_pru_r30_6,   OUTPUT | DIS |  MODE5 ->  00001101=0x0d

                    // This is for PRU1, the sample clock -- debug only
                    0x0a4 0x0d  // SAMP         P8_46   pr1_pru1_pru_r30_1,   OUTPUT | DIS |  MODE5 ->  00001101=0x0d
                >;
            };
        };
    };
    // Enable the PRUSS
    fragment@1 {         
        target = <&pruss>;
        __overlay__ {
            status = "okay";
            pinctrl-names = "default";
            pinctrl-0 = <&pru_pru_pins>;
        };
    };

};
